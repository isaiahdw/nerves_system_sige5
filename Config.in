## package/brcmfmac43752-firmware/Config.in
```kconfig
config BR2_PACKAGE_BRCMFMAC43752_FIRMWARE
	bool "brcmfmac43752-firmware"
	help
	  Firmware for the AP6275S combo module on the ArmSoM Sige5 v1.2+:
	  the Synaptics (Broadcom) BCM43752 SDIO WiFi side (firmware, CLM
	  blob and NVRAM) and the Bluetooth side's patchram, which the
	  controller asks for as brcm/BCM4362A2.hcd. Sourced from the
	  Armbian firmware collection; neither is covered by upstream
	  linux-firmware.

	  https://github.com/armbian/firmware
```

## package/optee-key/Config.in
```kconfig
config BR2_PACKAGE_OPTEE_KEY
	bool "optee-key"
	depends on BR2_PACKAGE_OPTEE_CLIENT
	help
	  Command line tool for a device key held in OP-TEE's PKCS #11
	  token: initialise the token, generate an EC P-256 keypair
	  inside the secure world, read back the public key, and sign
	  with the private one.

	  The private key is generated as a sensitive, non-extractable
	  token object, so it never leaves the trusted application.

	  A separate process rather than a library binding, because
	  Cryptoki is initialised here for single-threaded use and the
	  whole exchange with the TA happens on one thread.

comment "optee-key needs optee-client"
	depends on !BR2_PACKAGE_OPTEE_CLIENT
```

## package/rknpu-driver/Config.in
```kconfig
config BR2_PACKAGE_RKNPU_DRIVER
	bool "rknpu-driver"
	depends on BR2_LINUX_KERNEL
	help
	  Vendor RKNPU kernel driver (v0.9.8, Rockchip 6.1 BSP) built
	  out-of-tree against the mainline kernel, ported with a small
	  patch series. Provides /dev/dri render node ioctls for the
	  librknnrt runtime. The vendor's devfreq/OPP integration is
	  reimplemented on generic APIs, giving 300-900 MHz scaling, and
	  the NPU attaches to mainline's rockchip-iommu, so its buffers
	  are pageable rather than CMA-backed.

	  https://github.com/armbian/linux-rockchip
```
